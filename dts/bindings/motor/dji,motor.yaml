## dts/bindings/motor/dji,motor.yaml
```yaml
# Copyright (c) 2024 ttwards <12411711@mail.sustech.edu.cn>

# SPDX-License-Identifier: Apache-2.0

description: DJI Motor

compatible: "dji,motor"

include: [base.yaml]

properties:
  id:
    type: int
    required: true
  tx_id:
    type: int
    required: true
  rx_id:
    type: int
    required: true
  can_channel:
    type: phandle
    required: true
  gear_ratio:
    type: string
    required: true
  controllers:
    type: phandles
    required: false
  is_m3508:
    type: boolean
    required: false
  is_m2006:
    type: boolean
    required: false
  is_gm6020:
    type: boolean
    required: false
  is_dm_motor:
    type: boolean
    required: false
  dm_i_max:
    type: string
    required: false
  dm_torque_ratio:
    type: string
    required: false
  minor_arc:
    type: boolean
    required: false
  inverse:
    type: boolean
    required: false
  follow:
    type: phandle
    required: false
```

## dts/bindings/motor/dm,motor.yaml
```yaml
# Copyright (c) 2024 ttwards <12411711@mail.sustech.edu.cn>

# SPDX-License-Identifier: Apache-2.0

description: Da Miao Motor

compatible: "dm,motor"

include: [base.yaml]

properties:
  id:
    type: int
  tx_id:
    type: int
    required: true
  rx_id:
    type: int
    required: true
  can_channel:
    type: phandle
    required: true
  controllers:
    type: phandles
    required: false
  v_max:
    type: string
  p_max:
    type: string
  t_max:
    type: string
  freq:
    type: int
```

## dts/bindings/motor/mi,motor.yaml
```yaml
description: Xiao Mi Motor

compatible: "mi,motor"

include: [base.yaml]

properties:
  id:
    type: int
  tx_id:
    type: int
    required: true
  rx_id:
    type: int
    required: true
  can_channel:
    type: phandle
    required: true
  gear_ratio:
    type: string
    required: true
  controllers:
    type: phandles
    required: false
```

## dts/bindings/motor/rs,motor.yaml
```yaml
description: Robstride Motor

compatible: "rs,motor"

include: [base.yaml]

properties:
  id:
    type: int
    required: true
  rx_id:
    type: int
    required: true
  tx_id:
    type: int
    required: true
  motor_type:
    type: string
    required: true
  can_channel:
    type: phandle
    required: true
  controllers:
    type: phandles
    required: true
  capabilities:
    type: string-array
    required: true
  auto_report:
    type: boolean
  v_max:
    type: string
    required: false
  p_max:
    type: string
    required: false
  t_max:
    type: string
    required: false
```

## dts/bindings/motor/vesc,motor.yaml
```yaml
# Copyright (c) 2026 EclipseaHime017 <12210226@mail.sustech.edu.cn>

# SPDX-License-Identifier: Apache-2.0

description: VESC Motor

compatible: "vesc,motor"

include: [base.yaml]

properties:
  id:
    type: int
    required: true
  can_channel:
    type: phandle
    required: true
  gear_ratio:
    type: string
    required: true
  controllers:
    type: phandles
    required: false
  kv:
    type: string
    required: true
  pole_pairs:
    type: string
    required: true
  v_max:
    type: string
    required: true
  p_max:
    type: string
    required: true
  t_max:
    type: string
    required: true
  i_max:
    type: string
    required: true
  freq:
    type: int
    description: VESC active ping frequency in Hz for online/offline detection.
```

## dts/bindings/motor/yinshi,la.yaml
```yaml
description: Yinshi Robotics Micro Servo Electric Cylinder (LA series)

compatible: "yinshi,la"

properties:
  uart:
    type: phandle
    required: true
    description: |
      UART device for communication. For D-type interface, use
      3.3V LVTTL UART at 921600 baud. For 2-type (RS485) interface,
      use RS485 UART at 115200 baud with de-gpios for direction control.

  id:
    type: int
    default: 1
    description: |
      Device ID on the UART bus (1-254). Multiple actuators sharing
      the same bus must have different IDs. 255 is the broadcast ID.

  de-gpios:
    type: phandle-array
    required: false
    description: |
      RS485 driver-enable (DE) GPIO. Required for 2-type (RS485)
      interface. When specified, the driver controls this pin to
      switch between TX (high) and RX (low). Omit for D-type
      (full-duplex TTL UART) interface.

  max-retries:
    type: int
    default: 3
    description: |
      Maximum retry count for position commands that expect a reply.

  reply-timeout-ms:
    type: int
    default: 5
    description: |
      Timeout in milliseconds to wait for a reply frame before retrying.
      The actuator responds in 120-800us; 5ms provides generous margin.
```

## dts/bindings/pid/pid.mit.yaml
```yaml
# Copyright (c) 2024 ttwards <12411711@mail.sustech.edu.cn>

# SPDX-License-Identifier: Apache-2.0

description: PID MIT Controller

compatible: "pid,mit"

include: [base.yaml]

properties:
  k_p:
    type: string
    required: true
  k_i:
    type: string
  k_d:
    type: string
  i_max:
    type: string
  out_max:
    type: string
  offset:
    type: string
  detri_lpf:
    type: string
```

## dts/bindings/sensor/pixart,paw3395.yaml
```yaml
# Copyright (c) 2023, Your Name
# SPDX-License-Identifier: Apache-2.0

description: PAW3395 optical mouse sensor

compatible: "pixart,paw3395"

include: [spi-device.yaml, "sensor-device.yaml"]

properties:
  cs-gpios:
    type: phandle-array
    description: CS pin
    required: true
  ripple:
    type: boolean
    description: Enable ripple mode
  dpi:
    type: int
    description: DPI setting
    default: 20000
```

## dts/bindings/steerwheel/ares,mecanum.yaml
```yaml
# Copyright (c) 2025 ttwards <12411711@mail.sustech.edu.cn>

# SPDX-License-Identifier: Apache-2.0

description: Steer Wheel

compatible: "ares,mecanum"

include: [base.yaml]

properties:
  wheel-motor:
    type: phandle
    required: true
  wheel-radius:
    type: string
    required: true
  angle-offset:
    type: string
    required: true
  inverse-wheel:
    type: boolean
  free-angle:
    type: string

wheel-cells:
  - offset_x
  - offset_y
```

## dts/bindings/steerwheel/ares,steerwheel.yaml
```yaml
# Copyright (c) 2025 ttwards <12411711@mail.sustech.edu.cn>

# SPDX-License-Identifier: Apache-2.0

description: Steer Wheel

compatible: "ares,steerwheel"

include: [base.yaml]

properties:
  steer-motor:
    type: phandle
    required: true
  wheel-motor:
    type: phandle
    required: true
  wheel-radius:
    type: string
    required: true
  angle-offset:
    type: string
    required: true
  inverse-steer:
    type: boolean
  inverse-wheel:
    type: boolean
  multi_turn:
    type: boolean

wheel-cells:
  - offset_x
  - offset_y
```

## dts/bindings/transfer/ares,sbus.yaml
```yaml
# Copyright (c) 2024 ttwards <12411711@mail.sustech.edu.cn>

# SPDX-License-Identifier: Apache-2.0

description: SBUS

compatible: "ares,sbus"

properties:
  frame_size:
    description: Frame size
    type: int
    default: 25
  input_channels:
    description: Number of input channels
    type: int
    default: 16
  start_byte:
    description: Start byte
    type: int
    default: 0x0F
  end_byte:
    description: End byte
    type: int
    default: 0x00
```

## lib/ares/Kconfig
```kconfig
# ARES configuration options

# Copyright (c) 2025 ttwards <12411711@mail.sustech.edu.cn>
# SPDX-License-Identifier: Apache-2.0

rsource "interface/Kconfig"
rsource "protocol/Kconfig"

menuconfig ARES
    bool "ARES options"
    help
      Enable support for ares modules.

module = ARES
module-str = ARES

config UART_INTERFACE
	bool "UART_INTERFACE"
	help
	  Enable UART_INTERFACE

config USB_BULK_INTERFACE
	bool "USB_BULK_INTERFACE"
	help
	  Enable USB_BULK_INTERFACE

config BOARD_LOG_LEVEL
	int "BOARD_LOG_LEVEL"
	range 0 4
	default 3
	help
	  Set BOARD_LOG_LEVEL

config ARES_BOARD_STATUS_LED
	bool "ARES board status LED service"
	default y
	help
	  Enable the board status LED service that maps CPU usage to LED color.

config IMU_PWM_TEMP_CTRL
	select PID
    bool "IMU_PWM_TEMP_CTRL"
    help
      Enable IMU PWM TEMP CTRL

config AUTO_PROBE_GYRO_BIAS
	bool "AUTO_PROBE_GYRO_BIAS"
	help
	  Enable AUTO PROBE GYRO BIAS

config EKF_LIB
	bool "EKF_LIB"
	select CMSIS_DSP
	select CONFIG_CMSIS_DSP_MATRIX
	help
	  Enable EKF_LIB

config MAHONY_LIB
	bool "MAHONY_LIB"
	help
	  Enable MAHONY_LIB

config VOFA_LIB
	bool "VOFA_LIB"
	help
	  Enable VOFA_LIB

config MASTER_BOARD
	bool "MASTER_BOARD"
	help
	  Enable MASTER_BOARD

config SLAVE_BOARD
	bool "SLAVE_BOARD"
	help
	  Enable SLAVE_BOARD

config EXPERIMENTAL_BULK_LIB
	bool "EXPERIMENTAL_BULK_LIB"
	help
	  Enable EXPERIMENTAL_BULK_LIB

config ARES_COMM_LIB
	bool "ARES_COMM"
	help
	  Enable ARES_COMM_LIB
```

## lib/ares/connectivity/Kconfig
```kconfig
config USB_UART_ASYNC_ADAPTER
	bool "Enable USB UART async adapter"
	select SERIAL_SUPPORT_ASYNC
	help
	  Enables asynchronous adapter for UART drives that supports only
	  IRQ interface.

config UART_ASYNC_ADAPTER_LOG_LEVEL
	int "Log level for UART async adapter"
	range 0 7
	default 0
	help
	  Set the log level for the UART async adapter. The higher the number,
	  the more verbose the logs. The default is 4, which is a good balance
	  between verbosity and performance.
```

## lib/ares/interface/Kconfig
```kconfig
rsource "usb/Kconfig"
rsource "uart/Kconfig"

config USB_BULK_INTERFACE
	bool "USB_BULK_INTERFACE"
	help
	  Enable USB_BULK_INTERFACE
	select ARES_COMM_LIB
	select NET_BUF
	select USB_DEVICE_STACK_NEXT
	select UDC_WORKQUEUE

config UART_INTERFACE
	bool "UART_INTERFACE"
	help
	  Enable UART_INTERFACE
	select NET_BUF
```

## lib/ares/interface/uart/Kconfig
```kconfig
# Kconfig for ARES Custom USB Application

menu "ARES UART Application"

config ARES_UART_LOG_LEVEL
	int "Log level for ARES UART protocol"
	default 3
	help
	  Select the log level for the ARES UART protocol.
	  0=OFF, 1=ERR, 2=WRN, 3=INF, 4=DBG

config ARES_UART_THREAD_STACK_SIZE
    int "Stack size for ARES UART processing thread"
    default 1024
    help
      Specifies the stack size for the thread that processes incoming UART data.

endmenu # ARES UART Application
```

## lib/ares/interface/usb/Kconfig
```kconfig
# Kconfig for ARES Custom USB Application

# 顶层菜单，用于组织所有应用相关的配置
menu "ARES Custom USB Application"

config ARES_USB_BULK_LOG_LEVEL
	int "Log level for ARES USB Bulk driver"
	default 3
	help
	  Select the log level for the ARES USB Bulk driver.
	  0=OFF, 1=ERR, 2=WRN, 3=INF, 4=DBG

config ARES_USB_THREAD_STACK_SIZE
    int "Stack size for ARES USB processing thread"
    default 1024
    help
      Specifies the stack size for the thread that processes incoming USB data.

config ARES_USB_VID
	hex "USB vendor ID"
	default 0x1209
	help
	  Vendor ID used by the ARES USB bulk device.

config ARES_USB_PID
	hex "USB product ID"
	default 0x0001
	help
	  Product ID used by the ARES USB bulk device.

endmenu # ARES Custom USB Application
```

## lib/ares/protocol/Kconfig
```kconfig
# source "dual/Kconfig"

config DUAL_PROPOSE_PROTOCOL
	bool "DUAL_PROPOSE_PROTOCOL"
	help
	  Enable DUAL_PROPOSE_PROTOCOL
	select ARES_COMM_LIB

rsource "plotter/Kconfig"
```

## lib/ares/protocol/plotter/Kconfig
```kconfig
config ARES_PLOTTER_PROTOCOL
	bool "AresPlot Protocol"
	default n
	help
	  Enable AresPlot Protocol for real-time variable monitoring and plotting.
	  This protocol allows remote monitoring and control of MCU variables
	  through any Ares interface (UART, USB, etc.).

config PLOTTER
	bool "PLOTTER"
	select ARES_COMM_LIB
	select UART_INTERFACE
	select ARES_PLOTTER_PROTOCOL
	help
	  Enable PLOTTER

if ARES_PLOTTER_PROTOCOL

config ARESPLOT_MAX_VARS_TO_MONITOR
	int "Maximum number of variables to monitor"
	default 10
	range 1 50
	help
	  Maximum number of variables that can be monitored simultaneously.
	  Increase this value if you need to monitor more variables, but be
	  aware that it will increase memory usage.

config ARESPLOT_SHARED_BUFFER_SIZE
	int "Shared buffer size for protocol frames"
	default 256
	range 64 512
	help
	  Size of the buffer used for assembling and parsing protocol frames.
	  Should be large enough to contain the largest possible frame.

config ARESPLOT_ENABLE_ERROR_REPORT
	bool "Enable error reporting"
	default n
	help
	  Enable optional error reporting functionality. When enabled,
	  the protocol can send error reports to the host PC.

config ARESPLOT_FREQ
	int "Sampling frequency"
	default 500
	range 1 1000
	help
	  Sampling frequency in Hz.
	  This is the frequency at which the protocol will sample the variables.

endif # ARES_PLOTTER_PROTOCOL
```

## samples/chassis/sample.yaml
```yaml
sample:
  name: Chassis Driver Sample
tests:
  sample.drivers.chassis:
    tags: chassis motor
    integration_platforms:
      - native_sim
    harness: console
    harness_config:
      type: one_line
      regex:
        - ".*"
```

## src/ws2812_strip/Kconfig
```kconfig
# WS2812B LED Strip Kconfig

menuconfig WS2812_STRIP
	bool "WS2812B LED Strip support"
	select LED_STRIP
	help
	  Enable WS2812B (and compatible) LED strip support via SPI.
	  Requires the worldsemi,ws2812-spi compatible node in the
	  device tree (see dts/ws2812_strip.overlay for an example).

if WS2812_STRIP

config WS2812_STRIP_NUM_LEDS
	int "Number of LEDs in the strip"
	default 8
	help
	  Maximum number of addressable LEDs in the daisy chain.

config WS2812_STRIP_LOG_LEVEL
	int "WS2812 Strip log level"
	default 3
	help
	  Log level for the WS2812 strip module (0=none, 1=err, 2=wrn, 3=inf, 4=dbg).

endif # WS2812_STRIP
```

## tests/native_sim/pid/testcase.yaml
```yaml
# SPDX-License-Identifier: Apache-2.0

tests:
  ares.native_sim.pid:
    tags:
      - ares
      - native_sim
      - pid
    platform_allow:
      - native_sim/native/64
    integration_platforms:
      - native_sim/native/64
```

## west.yml
```yaml
# Copyright (c) 2021 Nordic Semiconductor ASA
# Copyright (c) 2025 ttwards @ SUSTech
# SPDX-License-Identifier: Apache-2.0

manifest:
  self:
    west-commands: scripts/west-commands.yml

  remotes:
    - name: zephyrproject-rtos
      url-base: https://www.github.com/zephyrproject-rtos

  projects:
    - name: zephyr
      remote: zephyrproject-rtos
      # Pinned to the Zephyr commit validated by the sample build matrix.
      revision: 6085aadeb337f27ee7411fa2ecbe8cf49164e360
      import:
        # By using name-allowlist we can clone only the modules that are
        # strictly needed by the application.
        name-allowlist:
          - cmsis      # required by the ARM port
          - cmsis_6
          - cmsis-dsp
          - hal_st
          - hal_stm32
          - mcuboot
          - segger
```
