## boards/damiao/dm_mc02/board.yml
```yaml
board:
  name: dm_mc02
  full_name: Damiao MC-02
  vendor: damiao
  socs:
    - name: stm32h723xx
```

## boards/damiao/dm_mc02/dm_mc02_defconfig
```kconfig
# Copyright (c) 2025 RobotPilots-SZU

# Enable MPU
CONFIG_ARM_MPU=y

# Enable HW stack protection
CONFIG_HW_STACK_PROTECTION=y

# Enable drivers
CONFIG_DMA=y
CONFIG_GPIO=y
CONFIG_COUNTER=y
CONFIG_PWM=y
CONFIG_SERIAL=y
CONFIG_SPI=y
CONFIG_I2C=y
CONFIG_CAN=y

# On-board devices
CONFIG_LED_STRIP=y
CONFIG_SENSOR=y
CONFIG_BMI08X=y

# Board status LED uses scheduler runtime stats to show CPU load.
CONFIG_THREAD_RUNTIME_STATS=y
CONFIG_SCHED_THREAD_USAGE_ALL=y
```

## boards/dji/robomaster_board_a/board.yml
```yaml
board:
  name: robomaster_board_a
  full_name: DJI Robomaster Development Board A
  vendor: dji
  socs:
    - name: stm32f427xx
```

## boards/dji/robomaster_board_a/robomaster_board_a_defconfig
```kconfig
# Enable MPU
CONFIG_ARM_MPU=n

# Float i/o
CONFIG_CBPRINTF_FP_SUPPORT=y

# Enable HW stack protection
CONFIG_HW_STACK_PROTECTION=n

# enable GPIO
CONFIG_GPIO=y

#CAN
CONFIG_CAN_DEFAULT_BITRATE=1000000


CONFIG_ISR_STACK_SIZE=3200
CONFIG_MAIN_STACK_SIZE=3200
```

## boards/dji/robomaster_board_c/Kconfig.robomaster_board_c
```kconfig
# Copyright (c) 2024, ttwards <xuwenxi0517@gmail.com>
# SPDX-License-Identifier: Apache-2.0

config BOARD_ROBOMASTER_BOARD_C
	select SOC_STM32F407XG
```

## boards/dji/robomaster_board_c/board.yml
```yaml
board:
  name: robomaster_board_c
  full_name: DJI Robomaster Development Board C
  vendor: dji
  socs:
    - name: stm32f407xx
```

## boards/dji/robomaster_board_c/robomaster_board_c_defconfig
```kconfig
# Copyright (c) 2024, ttwards <xuwenxi0517@gmail.com>
# SPDX-License-Identifier: Apache-2.0

# Enable MPU
CONFIG_ARM_MPU=n

# Float i/o
CONFIG_CBPRINTF_FP_SUPPORT=y

# Enable HW stack protection
CONFIG_HW_STACK_PROTECTION=n

# enable GPIO
CONFIG_GPIO=y

# Enable UART console
CONFIG_SERIAL=y
CONFIG_UART_ASYNC_API=y
CONFIG_UART_INTERRUPT_DRIVEN=y

# 启用 Shell 支持
CONFIG_SHELL=n
CONFIG_SHELL_BACKENDS=n
CONFIG_SHELL_BACKEND_SERIAL=n

# 启用 UART 控制台
CONFIG_UART_CONSOLE=y

# 禁用 SEGGER RTT
CONFIG_USE_SEGGER_RTT=n

# 启用事件支持
CONFIG_EVENTS=y

# 启用控制台支持
CONFIG_CONSOLE=y

CONFIG_LOG=y
CONFIG_LOG_MODE_IMMEDIATE=y

CONFIG_SPI=y
CONFIG_SPI_STM32_DMA=y

CONFIG_DMA=y

CONFIG_FPU=y

CONFIG_PWM=y

CONFIG_LOG=y

CONFIG_DMA_STM32=y

CONFIG_THREAD_ANALYZER=y
CONFIG_SCHED_THREAD_USAGE=y

CONFIG_ISR_STACK_SIZE=3200
CONFIG_MAIN_STACK_SIZE=3200

CONFIG_CAN_COUNT=2
```

## drivers/Kconfig
```kconfig
# Copyright (c) 2024 ttwards <12411711@mail.sustech.edu.cn>
# SPDX-License-Identifier: Apache-2.0

menu "Device Drivers"
rsource "motor/Kconfig"
rsource "transfer/Kconfig"
rsource "chassis/Kconfig"
rsource "wheel/Kconfig"
rsource "pid/Kconfig"
rsource "sensor/Kconfig"
rsource "vcan/Kconfig"
endmenu
```

## drivers/chassis/Kconfig
```kconfig
# Chassis driver configuration options

# Copyright (c) 2025 ttwards <12411711@mail.sustech.edu.cn>
# SPDX-License-Identifier: Apache-2.0

menuconfig CHASSIS
    bool "Chassis drivers"
	select WHEEL
    help
      Enable support for chassis.

if CHASSIS

module = CHASSIS
module-str = CHASSIS
source "subsys/logging/Kconfig.template.log_config"

config CHASSIS_LOG_LEVEL
    int "Motor log level"
    default 4
    help
      The log level of chassis driver

config CHASSIS_INIT_PRIORITY
	int "Chassis init priority"
	default 90
	help
	  The init priority of chassis driver

endif
```

## drivers/motor/la_yinshi/Kconfig
```kconfig
# Yinshi LA Series Micro Servo Electric Cylinder driver configuration
#
# Copyright (c) 2025 ttwards <12411711@mail.sustech.edu.cn>
# SPDX-License-Identifier: Apache-2.0

if LA_YINSHI

config LA_YINSHI_INIT_PRIORITY
	int "Yinshi LA driver init priority"
	default 90
	help
	  Device initialization priority for Yinshi LA electric cylinders.

module = LA_YINSHI
module-str = LA_YINSHI
source "subsys/logging/Kconfig.template.log_config"

endif # LA_YINSHI
```

## drivers/pid/Kconfig
```kconfig
# Motor driver configuration options

# Copyright (c) 2024 ttwards <12411711@mail.sustech.edu.cn>
# SPDX-License-Identifier: Apache-2.0

menuconfig PID_MUNU
    bool "PID drivers"
    help
      Enable support for PID devices.



module = PID_MUNU
module-str = PID_MUNU
source "subsys/logging/Kconfig.template.log_config"

config PID
    bool "PID"
    help
      Add support for PID

if PID_MUNU

endif
```

## drivers/sensor/Kconfig
```kconfig
# Copyright (c) 2024 ttwards <12411711@mail.sustech.edu.cn>
# SPDX-License-Identifier: Apache-2.0

menu "Device Drivers"
rsource "paw3395/Kconfig"
rsource "WIT_HWT906/Kconfig"
endmenu
```

## drivers/sensor/WIT_HWT906/Kconfig
```kconfig
menuconfig WIT_HWT906
    bool "WIT HWT906 IMU Driver"
    depends on SENSOR
    depends on SERIAL
    select UART_INTERRUPT_DRIVEN
    help
      Enable driver for WIT HWT906 9-axis IMU sensor.
      The sensor communicates via UART.

if WIT_HWT906

config WIT_HWT906_THREAD_STACK_SIZE
    int "Thread stack size"
    default 1024
    help
      Stack size for the internal data processing thread.

config WIT_HWT906_THREAD_PRIORITY
    int "Thread priority"
    default 5
    help
      Priority for the internal data processing thread.

endif # WIT_HWT906
```

## drivers/sensor/paw3395/Kconfig
```kconfig
# PAW3395 optical mouse sensor configuration options

# Copyright (c) 2023, Your Name
# SPDX-License-Identifier: Apache-2.0

menuconfig PAW3395
    bool "PAW3395 optical mouse sensor"
    default y
    depends on DT_HAS_PIXART_PAW3395_ENABLED
    select SPI
    help
      Enable driver for PAW3395 optical mouse sensor.

if PAW3395

config PAW3395_TRIGGER
    bool "Trigger support"
    help
      Enable trigger support for PAW3395 sensor.

endif # PAW3395
```

## drivers/transfer/Kconfig
```kconfig
# Motor driver configuration options

# Copyright (c) 2024 ttwards <12411711@mail.sustech.edu.cn>
# SPDX-License-Identifier: Apache-2.0

menuconfig ARES
    bool "ARES drivers"
    help
      Enable support for ARES devices.

if ARES

module = ARES
module-str = ARES
source "subsys/logging/Kconfig.template.log_config"

config SBUS_LOG_LEVEL
    int "sbus log level"
    default 4
    help
      The log level of sbus driver

config SBUS_INIT_PRIORITY
    int "Sbus init priority"
    default 90
    help
      The init priority of sbus driver

config ARES_SBUS
    bool "ARES_SBUS"
    help
      Add support for sbus

endif
```

## drivers/vcan/Kconfig
```kconfig
menuconfig VCAN
    bool "Virtual dual-channel CAN over SPI"
    default y
    depends on CAN && SPI && GPIO
    depends on DT_HAS_CUSTOM_SPI_CAN_MFD_ENABLED
    help
      Enable the SPI-hosted virtual CAN bridge driver. The bridge exposes two
      child CAN devices backed by a remote target connected over SPI.
      The host-side SPI timing follows the local src/master example:
      8-bit words, MSB first, CPHA, master mode, and manual CS toggling.
      For higher throughput, enable DMA in the board/app config; on STM32
      targets also enable the controller interrupt path such as
      CONFIG_SPI_STM32_INTERRUPT when available.

if VCAN

config VCAN_MAX_RX_FILTER
    int "Maximum software RX filters per virtual CAN node"
    default 16
    range 1 64
    help
      Number of local software RX filters supported by each hosted CAN
      channel.

config VCAN_TX_QUEUE_DEPTH
    int "VCAN per-channel TX queue depth"
    default 32
    range 4 256
    help
      Number of host-side CAN frames buffered per virtual channel before
      backpressure is applied to callers of can_send(). Keeping this bounded
      ensures the driver degrades via queue backpressure instead of unbounded
      memory growth when the remote link or CAN bus is saturated.

config VCAN_MAX_SERVICE_BATCH
    int "Maximum SPI sync transfers processed per wake"
    default 8
    range 1 64
    help
      Upper bound on back-to-back SPI sync transactions handled by the VCAN
      poll thread before it yields. This prevents VCAN from monopolizing CPU
      time under sustained load while still allowing the pending queues to
      drain over subsequent wakeups.

config VCAN_WORKQ_STACK_SIZE
    int "VCAN poll thread stack size"
    default 1536
    range 512 8192
    help
      Stack size used by the parent SPI bridge polling thread. The thread runs
      every 500 us and performs a SPI sync transfer only when there are local
      TX/control updates pending or the slave INT line is asserted.

config VCAN_WORKQ_PRIORITY
    int "VCAN poll thread priority"
    default 0
    help
      Priority for the parent SPI bridge polling thread.

config VCAN_INIT_PRIORITY
    int "VCAN parent init priority"
    default CAN_INIT_PRIORITY
    help
      Initialization priority for the SPI bridge parent device.

config VCAN_NODE_INIT_PRIORITY
    int "VCAN child init priority"
    default 81
    help
      Initialization priority for the hosted CAN child devices. This should be
      higher than the parent SPI bridge priority so the parent is ready first.

endif # VCAN
```

## drivers/wheel/Kconfig
```kconfig
# Chassis driver configuration options

# Copyright (c) 2025 ttwards <12411711@mail.sustech.edu.cn>
# SPDX-License-Identifier: Apache-2.0

menuconfig WHEEL
    bool "Wheel drivers"
    help
      Enable support for wheels.

if WHEEL

module = WHEEL
module-str = WHEEL
source "subsys/logging/Kconfig.template.log_config"

endif
```

## dts/bindings/can/custom,spi-can-mfd.yaml
```yaml
# Copyright (c) 2026
# SPDX-License-Identifier: Apache-2.0

description: Virtual dual-channel CAN host controller over SPI

compatible: "custom,spi-can-mfd"

include: [spi-device.yaml]

properties:
  can-core-clock:
    type: int
    required: true
    description: |
      Remote CAN controller core clock in Hz. The host uses this value when
      converting Zephyr CAN timing requests into a target bitrate that the
      slave recomputes locally.

  int-gpios:
    type: phandle-array
    required: true
    description: |
      Interrupt line asserted by the remote target to notify the host that one
      of the hosted CAN channels has pending RX data or a state change.

  host-int-gpios:
    type: phandle-array
    description: |
      Optional legacy reverse hint line. The current host driver uses a fixed
      2 kHz polling loop and does not require this signal to function.

child-binding:
  description: Hosted CAN controller channel exposed by the SPI bridge.

  properties:
    can-channel:
      type: int
      required: true
      enum:
        - 0
        - 1
      description: Remote CAN channel index on the target board.
```

## dts/bindings/can/custom,spi-can-node.yaml
```yaml
# Copyright (c) 2026
# SPDX-License-Identifier: Apache-2.0

description: CAN controller channel hosted by a custom SPI virtual CAN bridge

compatible: "custom,spi-can-node"

include: [can-controller.yaml]

properties:
  can-channel:
    type: int
    required: true
    enum:
      - 0
      - 1
    description: Remote CAN channel index on the parent SPI bridge.
```

## dts/bindings/canbus/vnd,canbus.yaml
```yaml
# Copyright (c) 2024 ttwards <12411711@mail.sustech.edu.cn>

# SPDX-License-Identifier: Apache-2.0

description: Motor CAN bus

compatible: "vnd,canbus"

include: [base.yaml]

properties:
  can_device:
    type: phandle
    required: true
```

## dts/bindings/chassis/ares,chassis.yaml
```yaml
# Copyright (c) 2025 ttwards <12411711@mail.sustech.edu.cn>

# SPDX-License-Identifier: Apache-2.0

description: Multi Wheel Chassis

compatible: "ares,chassis"

include: [base.yaml]

properties:
  wheels:
    type: phandle-array
    required: true
    specifier-space: wheel
  speed-limit:
    type: string
  angle-pid:
    type: phandle
    required: true
  track_angle:
    type: boolean
  max_gyro:
    type: string
  max_linear_accel:
    type: string
```

## dts/bindings/imu/gyro-bias.yaml
```yaml
# Copyright (c) 2024 ttwards <12411711@mail.sustech.edu.cn>

# SPDX-License-Identifier: Apache-2.0

description: Biases of IMU

compatible: "gyro-bias"

properties:
  gyro-bias:
    description: Gyroscope bias
    type: string-array
    required: true
```

## dts/bindings/motor-controller/motor-controller,mit.yaml
```yaml
description: Motor MIT controller

compatible: "motor-controller,mit"

include: [base.yaml]

properties:
  k_p:
    type: string
  k_i:
    type: string
  k_d:
    type: string
  i_max:
    type: string
  out_max:
    type: string
  offset:
    type: string
  detri_lpf:
    type: string
```

## dts/bindings/motor-controller/motor-controller,pv.yaml
```yaml
description: Motor cascaded position-velocity controller

compatible: "motor-controller,pv"

include: [base.yaml]

properties:
  pos_k_p:
    type: string
  pos_k_i:
    type: string
  pos_k_d:
    type: string
  pos_i_max:
    type: string
  pos_out_max:
    type: string
  pos_offset:
    type: string
  pos_detri_lpf:
    type: string
  vel_k_p:
    type: string
  vel_k_i:
    type: string
  vel_k_d:
    type: string
  vel_i_max:
    type: string
  vel_out_max:
    type: string
  vel_offset:
    type: string
  vel_detri_lpf:
    type: string
  i_max:
    type: string
  out_max:
    type: string
  offset:
    type: string
  detri_lpf:
    type: string
```

## dts/bindings/motor-controller/motor-controller,vo.yaml
```yaml
description: Motor single target controller

compatible: "motor-controller,vo"

include: [base.yaml]

properties:
  target:
    type: string
    enum:
      - "torque"
      - "speed"
    default: "speed"
  k_p:
    type: string
  k_i:
    type: string
  k_d:
    type: string
  i_max:
    type: string
  out_max:
    type: string
  offset:
    type: string
  detri_lpf:
    type: string
```
