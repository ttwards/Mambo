## CMakeLists.txt
```
# SPDX-License-Identifier: Apache-2.0

cmake_minimum_required(VERSION 3.20.0)
set(CMAKE_CXX_STANDARD 17)
find_package(Zephyr REQUIRED HINTS $ENV{ZEPHYR_BASE})
project(IMU)

file(GLOB app_sources src/*.c)

target_sources(app PRIVATE ${app_sources})
```

## sample.yaml
```
sample:
  name: IMU Accelerometer Calibration
  description: Calibrate the accelerometer using Levenberg-Marquardt optimization.
tests:
  sample.ares.imu.calibrate:
    tags: sensor imu calibration
    depends_on: sensor
    integration_platforms:
      - robomaster_board_c
    harness: console
    harness_config:
      type: multi_line
      regex:
        - "Starting Accelerometer Calibration..."
```

## prj.conf
```kconfig
# 启用线程分析器
CONFIG_THREAD_ANALYZER=y
CONFIG_THREAD_ANALYZER_USE_LOG=y
CONFIG_THREAD_ANALYZER_USE_PRINTK=n
CONFIG_THREAD_NAME=y
# CONFIG_THREAD_ANALYZER_AUTO=y
# CONFIG_THREAD_ANALYZER_AUTO_INTERVAL=5
CONFIG_THREAD_ANALYZER_LOG_LEVEL_INF=y
CONFIG_THREAD_ANALYZER_AUTO_SEPARATE_CORES=n

# 启用 Shell 支持
CONFIG_SHELL=n
CONFIG_SHELL_BACKENDS=n
CONFIG_SHELL_BACKEND_SERIAL=n

# 启用 UART 控制台
CONFIG_UART_CONSOLE=y

# 禁用 SEGGER RTT
CONFIG_USE_SEGGER_RTT=n

# 启用事件支持
CONFIG_EVENTS=y

# 启用控制台支持
CONFIG_CONSOLE=y

# 启用日志系统
CONFIG_LOG=y
CONFIG_LOG_MODE_IMMEDIATE=y
CONFIG_LOG_PRINTK=y
CONFIG_LOG_BACKEND_UART=y
# CONFIG_LOG_MODE_IMMEDIATE=y

# 启用串行支持
CONFIG_SERIAL=y

# 禁用优化
CONFIG_NO_OPTIMIZATIONS=n

CONFIG_DMA=y
CONFIG_DMA_STM32=y  # STM32 DMA 驱动
CONFIG_UART_STM32=y # STM32 UART 驱动
# CONFIG_STM32_UART_DMA=y

# CONFIG_HAS_STM32CUBE=y
# CONFIG_USE_STM32_HAL_DMA=y
CONFIG_SPI=y
CONFIG_SPI_STM32=y

CONFIG_CMSIS_DSP=y
CONFIG_CMSIS_DSP_MATRIX=y
CONFIG_CMSIS_DSP_CONTROLLER=y
CONFIG_CMSIS_DSP_FASTMATH=y

CONFIG_AUTO_PROBE_GYRO_BIAS=y

# NVS
CONFIG_NVS=y
CONFIG_NVS_LOG_LEVEL_INF=y # 可选：启用一些NVS信息日志

# Flash and Flash Map
CONFIG_FLASH=y
CONFIG_FLASH_MAP=y

# **重要：为了数据完整性检查，启用数据CRC**
CONFIG_NVS_DATA_CRC=y

# 如果你的应用使用了MPU，并且NVS操作导致MPU fault或-ETIMEDOUT，需要启用这个
# CONFIG_MPU_ALLOW_FLASH_WRITE=y

# 其他配置...
CONFIG_PRINTK=y
CONFIG_SERIAL=y
# 根据你的板子配置 UART
# CONFIG_UART_CONSOLE=y

CONFIG_SENSOR=y
CONFIG_SENSOR_ASYNC_API=y

CONFIG_BMI08X=y
CONFIG_BMI08X_ACCEL_TRIGGER_OWN_THREAD=y
CONFIG_BMI08X_ACCEL_THREAD_PRIORITY=10
CONFIG_BMI08X_ACCEL_THREAD_STACK_SIZE=2048
CONFIG_BMI08X_GYRO_TRIGGER_OWN_THREAD=y
CONFIG_BMI08X_GYRO_THREAD_PRIORITY=10
CONFIG_BMI08X_GYRO_THREAD_STACK_SIZE=2048
CONFIG_BMI08X_I2C_WRITE_BURST_SIZE=16

CONFIG_IMU_PWM_TEMP_CTRL=y
CONFIG_PID=y

CONFIG_FLASH=y
CONFIG_FLASH_MAP=y

CONFIG_ZMS=y

CONFIG_CMSIS_DSP=y
CONFIG_CMSIS_DSP_MATRIX=y
CONFIG_CMSIS_DSP_CONTROLLER=y
CONFIG_CMSIS_DSP_FASTMATH=y

CONFIG_LOG=y
CONFIG_LOG_BLOCK_IN_THREAD=y

# CONFIG_VOFA_LIB=y

CONFIG_MAIN_STACK_SIZE=4096
```

## boards/robomaster_board_c.overlay
```dts
/* SPDX-License-Identifier: Apache-2.0 */

/* 定位到你的板子的 flash controller 节点，通常是 &flash0 或类似名称 */
/* 对于 stm32f407vg_disc1 或类似板子，通常是 &flash0 */
&flash0 {
	partitions {
		compatible = "fixed-partitions";
		#address-cells = <1>;
		#size-cells = <1>;

		/* Sector 10 base: 0x080C0000, size: 128KB */
		/* Sector 11 base: 0x080E0000, size: 128KB */
		/* 我们使用 Sector 10 和 Sector 11，总共 256KB */
		storage_partition: partition@c0000 {
			label = "storage";
			/* 从 Sector 10 开始 (0x080C0000)，大小为 256KB (0x40000) */
			reg = <0x00C0000 0x00040000>;
		};
	};
};
```

## src/devices.h
```c
#include <zephyr/device.h>
#include <zephyr/kernel.h>
#include <zephyr/drivers/motor.h>
#include <zephyr/drivers/gpio.h>

/* Devicetree */
// #define UART_NODE DT_ALIAS(vofa)
// const struct device *uart_dev = DEVICE_DT_GET(UART_NODE);

#define ACCEL_NODE DT_NODELABEL(bmi08x_accel)
const struct device *accel_dev = DEVICE_DT_GET(ACCEL_NODE);

#define GYRO_NODE DT_NODELABEL(bmi08x_gyro)
const struct device *gyro_dev = DEVICE_DT_GET(GYRO_NODE);

#define BUTTON_NODE DT_CHOSEN(zephyr_button)
const struct device *button_dev = DEVICE_DT_GET(BUTTON_NODE);

static const struct gpio_dt_spec button = GPIO_DT_SPEC_GET_OR(BUTTON_NODE, gpios, {0});
static struct gpio_callback button_cb_data;
```

## src/matrix_storage.c
```c
/*
 * Copyright (c) 2024 BayLibre SAS
 * Copyright (c) 2024 Your Name/Company // Add your copyright
 *
 * SPDX-License-Identifier: Apache-2.0
 */

#include "matrix_storage.h"
#include "zephyr/logging/log_core.h"

#include <zephyr/kernel.h>
#include <zephyr/device.h>
#include <zephyr/drivers/flash.h>
#include <zephyr/storage/flash_map.h>
#include <zephyr/fs/zms.h>
#include <zephyr/sys/util.h> // For ARRAY_SIZE
#include <string.h>          // For memcpy
#include <errno.h>

#include <zephyr/logging/log.h>
// Define CONFIG_MATRIX_STORAGE_LOG_LEVEL in prj.conf
LOG_MODULE_REGISTER(matrix_storage, LOG_LEVEL_INF);

// --- Configuration ---

// The label of the partition designated in the device tree's chosen node
// (zephyr,storage-partition). Usually "storage".
#define MATRIX_STORAGE_PARTITION storage_partition

// The unique ID used within ZMS to store the matrix data.
// Pick a value unlikely to clash with other potential ZMS users.
#define MATRIX_DATA_ID 0x4D415452

// Derive flash parameters from the chosen partition
#define ZMS_PARTITION_DEVICE FIXED_PARTITION_DEVICE(MATRIX_STORAGE_PARTITION)
#define ZMS_PARTITION_OFFSET FIXED_PARTITION_OFFSET(MATRIX_STORAGE_PARTITION)
#define ZMS_PARTITION_SIZE   FIXED_PARTITION_SIZE(MATRIX_STORAGE_PARTITION)

// --- ZMS Instance and State ---

static struct zms_fs fs;
static bool zms_initialized;
static K_MUTEX_DEFINE(zms_lock); // Protect concurrent access to init and R/W

// Combined buffer structure for writing/reading
typedef struct {
	float matrix1[MATRIX_ROWS][MATRIX_COLS];
	float matrix2[MATRIX_ROWS][MATRIX_COLS];
} matrix_data_t;

// Calculate the exact size expected for the stored data
static const size_t expected_data_size = sizeof(matrix_data_t);

// --- Internal Functions ---

/**
 * @brief Initializes the ZMS filesystem instance.
 *
 * Should be called with the zms_lock held.
 * Does nothing if already initialized.
 *
 * @return 0 on success or if already initialized.
 * @return -errno code on failure.
 */
static int zms_fs_init(void)
{
	int rc = 0;

	if (zms_initialized) {
		return 0;
	}

	fs.flash_device = ZMS_PARTITION_DEVICE;
	if (!device_is_ready(fs.flash_device)) {
		LOG_ERR("Flash device %s not ready", fs.flash_device->name);
		return -ENODEV;
	}

	fs.offset = ZMS_PARTITION_OFFSET;

	// ZMS requires sector_size to be a power of 2 and >= flash page size.
	// We'll use the flash page size if it meets the criteria, otherwise
	// log an error (though ZMS might work if page size is smaller, it's
	// less efficient and not the primary design target).
	struct flash_pages_info page_info;

	rc = flash_get_page_info_by_offs(fs.flash_device, fs.offset, &page_info);
	if (rc != 0) {
		LOG_ERR("Failed to get page info for offset 0x%lx (err %d)", (long)fs.offset, rc);
		return rc;
	}

	// Basic check: ZMS requires sector size to be power of 2.
	// flash_get_page_info doesn't guarantee this, although common.
	if (page_info.size == 0 || !is_power_of_two(page_info.size)) {
		// ZMS technically only *prefers* power of 2 for alignment, but might
		// fail if write block size > page_info.size. Let's enforce power of 2.
		LOG_ERR("Flash page size %u is not a power of 2, required by ZMS", page_info.size);
		// If this happens, you might need to configure ZMS sector size manually
		// to a larger, power-of-2 value that's a multiple of page_info.size.
		return -EINVAL;
	}

	fs.sector_size = page_info.size;

	// Calculate sector count based on partition size
	if (ZMS_PARTITION_SIZE < fs.sector_size * ZMS_MIN_SECTOR_COUNT) {
		LOG_ERR("Partition size %u is too small for ZMS (need at least %u sectors of size "
			"%u)",
			ZMS_PARTITION_SIZE, ZMS_MIN_SECTOR_COUNT, fs.sector_size);
		return -ENOSPC; // Or -EINVAL
	}
	fs.sector_count = ZMS_PARTITION_SIZE / fs.sector_size;
	// ZMS needs at least 2 sectors (one active, one for GC)
	if (fs.sector_count < ZMS_MIN_SECTOR_COUNT) {
		LOG_ERR("Calculated sector count %u is less than ZMS minimum %d", fs.sector_count,
			ZMS_MIN_SECTOR_COUNT);
		return -EINVAL;
	}

	LOG_INF("Initializing ZMS on %s: offset=0x%lx, sector_size=%u, sector_count=%u",
		fs.flash_device->name, (long)fs.offset, fs.sector_size, fs.sector_count);

	rc = zms_mount(&fs);
	if (rc != 0) {
		LOG_ERR("Failed to mount ZMS filesystem (err %d)", rc);
		// Consider attempting zms_clear() here if mount fails badly?
		// For now, just report the error.
		return rc;
	}

	LOG_INF("ZMS mounted successfully.");
	zms_initialized = true;
	return 0;
}

// --- Public API Implementation ---

int matrix_storage_save(const float matrix1[MATRIX_ROWS][MATRIX_COLS],
			const float matrix2[MATRIX_ROWS][MATRIX_COLS])
{
	int rc;
	matrix_data_t data_to_write;

	if (matrix1 == NULL || matrix2 == NULL) {
		return -EINVAL;
	}

	k_mutex_lock(&zms_lock, K_FOREVER);

	rc = zms_fs_init();
	if (rc != 0) {
		goto out;
	}

	// Prepare the data buffer
	memcpy(data_to_write.matrix1, matrix1, sizeof(data_to_write.matrix1));
	memcpy(data_to_write.matrix2, matrix2, sizeof(data_to_write.matrix2));

	// Write the combined data
	rc = zms_write(&fs, MATRIX_DATA_ID, &data_to_write, sizeof(data_to_write));
	if (rc < 0) { // zms_write returns negative errno on error
		LOG_ERR("Failed to write matrix data (ID: 0x%x): %d", MATRIX_DATA_ID, rc);
		// rc already holds the errno
	} else {
		LOG_DBG("Matrices saved successfully (ID: 0x%x)", MATRIX_DATA_ID);
		rc = 0; // Success
	}

out:
	k_mutex_unlock(&zms_lock);
	return rc;
}

int matrix_storage_read(float matrix1[MATRIX_ROWS][MATRIX_COLS],
			float matrix2[MATRIX_ROWS][MATRIX_COLS])
{
	int rc;
	matrix_data_t read_data;

	if (matrix1 == NULL || matrix2 == NULL) {
		return -EINVAL;
	}

	k_mutex_lock(&zms_lock, K_FOREVER);

	rc = zms_fs_init();
	if (rc != 0) {
		goto out;
	}

	// Read the data from ZMS
	rc = zms_read(&fs, MATRIX_DATA_ID, &read_data, sizeof(read_data));

	if (rc < 0) { // Error during read (e.g., -ENOENT if not found)
		LOG_DBG("Failed to read matrix data (ID: 0x%x): %d", MATRIX_DATA_ID, rc);
		// rc already holds the errno
	} else if (rc != expected_data_size) {
		// Read succeeded, but size is wrong (corruption?)
		LOG_ERR("Read matrix data size mismatch (ID: 0x%x): expected %u, got %d",
			MATRIX_DATA_ID, (unsigned int)expected_data_size, rc);
		rc = -EIO; // Input/output error seems appropriate
	} else {
		// Read succeeded and size is correct
		memcpy(matrix1, read_data.matrix1, sizeof(read_data.matrix1));
		memcpy(matrix2, read_data.matrix2, sizeof(read_data.matrix2));
		LOG_DBG("Matrices read successfully (ID: 0x%x)", MATRIX_DATA_ID);
		rc = 0; // Success
	}

out:
	k_mutex_unlock(&zms_lock);
	return rc;
}

bool matrix_storage_exists(void)
{
	int rc;
	ssize_t data_len;
	bool exists = false;

	k_mutex_lock(&zms_lock, K_FOREVER);

	rc = zms_fs_init();
	if (rc != 0) {
		goto out; // Cannot determine existence if init fails
	}

	data_len = zms_get_data_length(&fs, MATRIX_DATA_ID);

	if (data_len < 0) {
		if (data_len == -ENOENT) {
			LOG_DBG("Matrix data (ID: 0x%x) does not exist.", MATRIX_DATA_ID);
			exists = false;
		} else {
			LOG_ERR("Error checking data length for ID 0x%x: %d", MATRIX_DATA_ID,
				(int)data_len);
			exists = false; // Treat errors as "does not exist" for safety
		}
	} else if (data_len != expected_data_size) {
		LOG_WRN("Matrix data (ID: 0x%x) exists but has wrong size: %d (expected %u)",
			MATRIX_DATA_ID, (int)data_len, (unsigned int)expected_data_size);
		exists = false; // Treat wrong size as not existing correctly
	} else {
		LOG_DBG("Matrix data (ID: 0x%x) exists with correct size.", MATRIX_DATA_ID);
		exists = true;
	}

out:
	k_mutex_unlock(&zms_lock);
	return exists;
}

int matrix_storage_delete(void)
{
	int rc;

	k_mutex_lock(&zms_lock, K_FOREVER);

	rc = zms_fs_init();
	if (rc != 0) {
		goto out;
	}

	rc = zms_delete(&fs, MATRIX_DATA_ID);
	if (rc < 0) {
		if (rc == -ENOENT) {
			LOG_DBG("Matrix data (ID: 0x%x) already deleted or never existed.",
				MATRIX_DATA_ID);
			rc = 0; // Treat as success
		} else {
			LOG_ERR("Failed to delete matrix data (ID: 0x%x): %d", MATRIX_DATA_ID, rc);
			// rc holds the error code
		}
	} else {
		LOG_DBG("Matrix data deleted successfully (ID: 0x%x)", MATRIX_DATA_ID);
		rc = 0; // Success
	}

out:
	k_mutex_unlock(&zms_lock);
	return rc;
}
```

## src/matrix_storage.h
```c
/*
 * Copyright (c) 2024 BayLibre SAS
 * Copyright (c) 2024 Your Name/Company // Add your copyright
 *
 * SPDX-License-Identifier: Apache-2.0
 */

#ifndef MATRIX_STORAGE_H_
#define MATRIX_STORAGE_H_

#include <stdbool.h>
#include <stddef.h> // For size_t

#define MATRIX_ROWS 3
#define MATRIX_COLS 3

#define ZMS_MIN_SECTOR_COUNT 2

/**
 * @brief Saves two 3x3 float matrices to ZMS storage.
 *
 * This function attempts to initialize the ZMS filesystem if not already done,
 * then writes the provided matrices under a predefined internal ID.
 *
 * @param matrix1 Pointer to the first 3x3 float matrix.
 * @param matrix2 Pointer to the second 3x3 float matrix.
 * @return 0 on success.
 * @return -errno code on failure (e.g., -ENOSPC, -EIO, -EINVAL).
 */
int matrix_storage_save(const float matrix1[MATRIX_ROWS][MATRIX_COLS],
			const float matrix2[MATRIX_ROWS][MATRIX_COLS]);

/**
 * @brief Reads two 3x3 float matrices from ZMS storage.
 *
 * This function attempts to initialize the ZMS filesystem if not already done,
 * then reads the matrices associated with a predefined internal ID.
 *
 * @param matrix1 Pointer to a buffer to store the first 3x3 float matrix.
 * @param matrix2 Pointer to a buffer to store the second 3x3 float matrix.
 * @return 0 on success.
 * @return -ENOENT if the matrices are not found in storage.
 * @return -EIO if the read data size does not match the expected size.
 * @return Other -errno codes on ZMS or flash driver failures.
 */
int matrix_storage_read(float matrix1[MATRIX_ROWS][MATRIX_COLS],
			float matrix2[MATRIX_ROWS][MATRIX_COLS]);

/**
 * @brief Checks if the matrices exist in ZMS storage.
 *
 * This function attempts to initialize the ZMS filesystem if not already done,
 * then checks for the presence and correct size of the matrix data.
 *
 * @return true if the matrices exist and have the correct size.
 * @return false if the matrices do not exist, have an incorrect size,
 *         or an error occurred during initialization or check.
 */
bool matrix_storage_exists(void);

/**
 * @brief Deletes the stored matrices from ZMS storage.
 *
 * This function attempts to initialize the ZMS filesystem if not already done,
 * then deletes the matrices associated with a predefined internal ID.
 *
 * @return 0 on success or if the item was already deleted.
 * @return -errno code on failure during deletion (e.g., -EIO). Note that
 *         -ENOENT from the underlying zms_delete is treated as success here.
 */
int matrix_storage_delete(void);

#endif /* MATRIX_STORAGE_H_ */
```
