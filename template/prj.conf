## CMakeLists.txt
```
cmake_minimum_required(VERSION 3.20.0)

find_package(Zephyr REQUIRED HINTS $ENV{ZEPHYR_BASE})
project(vesc_demo)

target_sources(app PRIVATE src/main.c)
```

## prj.conf
```kconfig
# 基础配置
CONFIG_MAIN_THREAD_PRIORITY=7
CONFIG_SYSTEM_WORKQUEUE_STACK_SIZE=2048

# 电机驱动支持
CONFIG_MOTOR=y

# CAN总线支持
CONFIG_CAN=y
CONFIG_CAN_INIT_PRIORITY=80

# PID控制器支持
CONFIG_PID=y
```

## app.overlay
```dts
/ {
    
};
```

## boards/your_board_name.overlay
```dts
/{

};
```

## src/main.c
```c
/**
 * @file main.c
 * write your description here
 */

#include <stdio.h>

int add(int a, int b);

int main() {

    /* initialize variables */
    int num1 = 5;                   // the first number
    int num2 = 10;                  // the second number
    int result = add(num1, num2);   //the result of adding num1 and num2

    /* print the result */
    printf("The sum of %d and %d is %d\n", num1, num2, result);
    return 0;
}

/**
 * @brief Adds two integers.
 *
 * @param a The first integer.
 * @param b The second integer.
 * @return The sum of a and b.
 */
int add(int a, int b) {
    return a + b;
}
```
