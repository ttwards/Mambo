## drivers/motor/Kconfig
```kconfig
# Motor driver configuration options

# Copyright (c) 2024 ttwards <12411711@mail.sustech.edu.cn>
# SPDX-License-Identifier: Apache-2.0

menuconfig MOTOR
    bool "Motor drivers"
    help
      Enable support for motors.

if MOTOR

module = MOTOR
module-str = MOTOR
source "subsys/logging/Kconfig.template.log_config"

config MOTOR_COMMON
    bool "MOTOR COMMON"
    help
      Add support for common motor drivers
	select CAN

config MOTOR_CAN_SCHED_REPLY_GUARD
	bool "Reserve CAN reply windows in motor scheduler"
	default y
	depends on MOTOR_COMMON
	help
	  Prevent the motor CAN scheduler from queueing another TX frame on the
	  same CAN controller immediately after a request frame that expects a
	  reply. This gives lower-priority motor reply frames a chance to win bus
	  arbitration under high load.

config MOTOR_CAN_SCHED_REPLY_GUARD_EXTRA_US
	int "Additional motor CAN reply guard time in microseconds"
	default 60
	depends on MOTOR_CAN_SCHED_REPLY_GUARD
	help
	  Extra time added after the calculated reply frame airtime. This covers
	  motor-side processing delay before the reply frame starts arbitration.

config MOTOR_CAN_SCHED_TX_LATENCY_TRACE
	bool "Trace motor CAN scheduler TX latency"
	default n
	depends on MOTOR_COMMON
	help
	  Record and log queue-to-TX-completion latency for motor CAN scheduler
	  frames. Enable this only when latency measurement is needed.

config MOTOR_TELEMETRY
	bool "Motor telemetry logging"
	default y
	help
	  Centralize motor link state logs and motor CAN scheduler health logs.

config MOTOR_TELEMETRY_CAN_LOG_INTERVAL_MS
	int "Motor telemetry CAN scheduler log interval in milliseconds"
	default 2000
	depends on MOTOR_TELEMETRY
	help
	  Minimum interval between repeated CAN scheduler pressure logs.

config LA_YINSHI
	bool "MOTOR LA YINSHI"
	help
	  Add support for Yinshi LA series electric cylinders
	select SERIAL

config MOTOR_DJI
    bool "MOTOR DJI"
    help
      Add support for dji motors
    select MOTOR_COMMON

config MOTOR_DM
    bool "MOTOR DM"
    help
      Add support for dm motors
    select MOTOR_COMMON

config MOTOR_GQ
    bool "MOTOR GQ"
    help
      Add support for Gaoqing motors over classic CAN or CAN FD.
    select MOTOR_COMMON

config MOTOR_DM_DEFAULT_FREQ_HZ
	int "Default DM motor request frequency in Hz"
	default 200
	depends on MOTOR_DM
	help
	  Control request frequency for DM motors.

config MOTOR_MI
    bool "MOTOR MI"
    help
      Add support for mi motors
    select MOTOR_COMMON

config MOTOR_RS
    bool "MOTOR RS"
    help
      Add support for rs motors
    select MOTOR_COMMON

config MOTOR_VESC
    bool "MOTOR VESC"
    help
      Add support for vesc motors
    select MOTOR_COMMON

config MOTOR_VESC_CONTROL_FREQ_HZ
	int "VESC control frame frequency in Hz"
	default 100
	depends on MOTOR_VESC
	help
	  Periodic latest-value control frame rate for VESC motors.

config MOTOR_LK
    bool "MOTOR LK"
    help
      Add support for lk motors
    select MOTOR_COMMON

config MOTOR_LOG_LEVEL
    int "Motor log level"
    default 4
    help
      The log level of motor driver

config MOTOR_INIT_PRIORITY
    int "Motor init priority"
    default 90
    help
      The init priority of motor driver

config CAN_COUNT
    int "CAN count"
    default 2
    help
      The number of CAN devices

rsource "la_yinshi/Kconfig"
endif
```

## dts/bindings/motor/gq,motor.yaml
```yaml
description: Gaoqing Motor

compatible: "gq,motor"

include: [base.yaml]

properties:
  id:
    type: int
    required: true
  tx_id:
    type: int
    required: false
    description: >
      CAN transmit ID override. If omitted, the driver uses the motor id for
      classic CAN control frames and protocol-defined extended IDs for
      configuration or CAN FD frames.
  rx_id:
    type: int
    required: false
    description: >
      CAN receive ID override. If omitted, the driver expects replies on
      motor id shifted left by 8, matching the vendor examples.
  can_channel:
    type: phandle
    required: true
  controllers:
    type: phandles
    required: false
  enable-canfd:
    type: boolean
    description: Use the Gaoqing CAN FD protocol instead of classic CAN 2.0.
```

## lib/ares/protocol/mqttlite/Kconfig
```kconfig
config ARES_MQTTLITE_PROTOCOL
	bool "ARES MQTT-like protocol"
	select ARES_COMM_LIB
	select NET_BUF
	help
	  Enable a small MQTT-like publish/subscribe protocol for ARES interfaces.

if ARES_MQTTLITE_PROTOCOL

config ARES_MQTTLITE_MAX_TOPIC_LEN
	int "Maximum topic/filter length"
	range 1 255
	default 64

config ARES_MQTTLITE_MAX_PAYLOAD_SIZE
	int "Maximum payload size"
	range 1 65535
	default 192

config ARES_MQTTLITE_MAX_FRAME_SIZE
	int "Maximum received frame size"
	range 16 65535
	default 272

config ARES_MQTTLITE_MAX_SUBSCRIPTIONS
	int "Maximum local subscriptions"
	range 1 32
	default 8

config ARES_MQTTLITE_MAX_TOPICS
	int "Maximum registered topic ids"
	range 1 64
	default 8

config ARES_MQTTLITE_MAX_INFLIGHT
	int "Maximum QoS inflight packets"
	range 1 32
	default 4

config ARES_MQTTLITE_RETRY_INTERVAL_MS
	int "QoS retry interval in milliseconds"
	range 10 60000
	default 200

config ARES_MQTTLITE_MAX_RETRIES
	int "Maximum QoS retries before timeout"
	range 1 255
	default 5

config ARES_MQTTLITE_LOG_LEVEL
	int "ARES MQTT-like protocol log level"
	range 0 4
	default 3

endif
```

## tests/native_sim/ares_communication/testcase.yaml
```yaml
# SPDX-License-Identifier: Apache-2.0

tests:
  ares.native_sim.communication:
    tags:
      - ares
      - native_sim
      - communication
    platform_allow:
      - native_sim
      - native_sim/native/64
    integration_platforms:
      - native_sim
      - native_sim/native/64
```

## tests/native_sim/mqttlite/testcase.yaml
```yaml
# SPDX-License-Identifier: Apache-2.0

tests:
  ares.native_sim.mqttlite:
    tags:
      - ares
      - native_sim
      - protocol
    platform_allow:
      - native_sim
      - native_sim/native/64
    integration_platforms:
      - native_sim
      - native_sim/native/64
```

## tests/native_sim/wheel_chassis/testcase.yaml
```yaml
# SPDX-License-Identifier: Apache-2.0

tests:
  ares.native_sim.wheel_chassis:
    tags:
      - ares
      - native_sim
      - wheel
      - chassis
    platform_allow:
      - native_sim
      - native_sim/native/64
    integration_platforms:
      - native_sim
      - native_sim/native/64
```
