## CMakeLists.txt
```
# SPDX-License-Identifier: Apache-2.0

cmake_minimum_required(VERSION 3.20.0)
set(CMAKE_CXX_STANDARD 17)
find_package(Zephyr REQUIRED HINTS $ENV{ZEPHYR_BASE})
project(motor)

FILE(GLOB app_sources src/*.c)

include_directories(${ZEPHYR_BASE}/include)
include_directories(${CMAKE_CURRENT_SOURCE_DIR}/include)
include_directories(${CMAKE_CURRENT_SOURCE_DIR}/dts)
target_sources(app PRIVATE ${app_sources})
target_include_directories(app PRIVATE ${ZEPHYR_BASE}/include)
target_include_directories(app PRIVATE ${CMAKE_CURRENT_SOURCE_DIR}/include)
target_include_directories(app PRIVATE ${CMAKE_CURRENT_SOURCE_DIR}/dts)
```

## prj.conf
```kconfig
# 禁用优化
# CONFIG_NO_OPTIMIZATIONS=n
# CONFIG_COMPILER_OPT="-O3 -fno-strict-overflow -fno-common -ffunction-sections -fdata-sections -ffreestanding -fno-builtin"

# 启用驱动
# CONFIG_MOTOR=y
# CONFIG_MOTOR_COMMON=y
# CONFIG_MOTOR_DJI=y
# CONFIG_MOTOR_DM=y
CONFIG_MOTOR_LOG_LEVEL=4
# CONFIG_CAN=y
# CONFIG_MOTOR_INIT_PRIORITY=90

CONFIG_ARES=y
# CONFIG_ARES_SBUS=y
CONFIG_EKF_LIB=y
CONFIG_AUTO_PROBE_GYRO_BIAS=y

# PWM 配置
CONFIG_PWM=y
CONFIG_PWM_STM32=y

# 日志配置
CONFIG_LOG=y
CONFIG_LOG_DEFAULT_LEVEL=4
CONFIG_LOG_MAX_LEVEL=4
CONFIG_PWM_LOG_LEVEL_DBG=y

# UART 配置
CONFIG_UART_INTERFACE=y
CONFIG_CONSOLE=y
CONFIG_UART_CONSOLE=y

# CONFIG_USB_BULK_INTERFACE=y

# CONFIG_DUAL_PROPOSE_PROTOCOL=y
# CONFIG_SEGGER_SYSTEMVIEW=y
# CONFIG_TRACING_SYSCALL=n
# CONFIG_CHASSIS=y

# USB 日志级别配置
CONFIG_USBD_LOG_LEVEL_WRN=y

# 其他调试配置
CONFIG_LOG_PRINTK=y
CONFIG_LOG_MODE_IMMEDIATE=y
```

## boards/robomaster_board_c.overlay
```dts
/ {
	// servo: servo {
	// 	compatible = "pwm-servo";
	// 	pwms = <&pwm0 1 PWM_MSEC(20) PWM_POLARITY_NORMAL>;
	// 	min-pulse = <PWM_USEC(500)>;
	// 	max-pulse = <PWM_USEC(2500)>;
	// };
};
```

## src/main.c
```c
#include <zephyr/kernel.h>
#include <zephyr/device.h>
#include <zephyr/drivers/pwm.h>
#include <zephyr/logging/log.h>

LOG_MODULE_REGISTER(main, LOG_LEVEL_DBG);

#define PWM0_NODE DT_NODELABEL(pwm0)
#define PWM1_NODE DT_NODELABEL(pwm1)

const struct device *pwm0_dev = DEVICE_DT_GET(PWM0_NODE);
const struct device *pwm1_dev = DEVICE_DT_GET(PWM1_NODE);

#define PWM_PERIOD_USEC 20000 // 20ms周期
#define MIN_PULSE_USEC  1000  // 1ms最小脉宽
#define MAX_PULSE_USEC  2000  // 2ms最大脉宽

// 角度转占空比
static uint32_t angle_to_pulse_width(float angle, float max_angle)
{
	float range = MAX_PULSE_USEC - MIN_PULSE_USEC;
	return MIN_PULSE_USEC + (uint32_t)((angle / max_angle) * range);
}

void main(void)
{
	// printk("Servomotor control starting...\n");

	if (!device_is_ready(pwm0_dev)) {
		// printk("Error: PWM0 device not ready\n");
		return;
	}

	if (!device_is_ready(pwm1_dev)) {
		// printk("Error: PWM1 device not ready\n");
		return;
	}

	// printk("PWM devices ready\n");
	k_msleep(100);

	while (1) {
		// 0度
		// printk("Setting 0 degrees\n");
		pwm_set(pwm0_dev, 1, PWM_USEC(PWM_PERIOD_USEC),
			PWM_USEC(angle_to_pulse_width(0, 180.0f)), 0);
		pwm_set(pwm1_dev, 1, PWM_USEC(PWM_PERIOD_USEC),
			PWM_USEC(angle_to_pulse_width(0, 270.0f)), 0);
		k_msleep(2000);

		// 90度/135度
		// printk("Setting middle position\n");
		pwm_set(pwm0_dev, 1, PWM_USEC(PWM_PERIOD_USEC),
			PWM_USEC(angle_to_pulse_width(90, 180.0f)), 0);
		pwm_set(pwm1_dev, 1, PWM_USEC(PWM_PERIOD_USEC),
			PWM_USEC(angle_to_pulse_width(135, 270.0f)), 0);
		k_msleep(2000);

		// 最大角度
		// printk("Setting maximum angles\n");
		pwm_set(pwm0_dev, 1, PWM_USEC(PWM_PERIOD_USEC),
			PWM_USEC(angle_to_pulse_width(180, 180.0f)), 0);
		pwm_set(pwm1_dev, 1, PWM_USEC(PWM_PERIOD_USEC),
			PWM_USEC(angle_to_pulse_width(270, 270.0f)), 0);
		k_msleep(2000);
	}
}
```
